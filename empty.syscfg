// These arguments were used when this file was generated. They will be automatically applied on subsequent loads 
// via the GUI or CLI invocations. Run CLI with '--help' for additional information on how to override these arguments.
// @cliArgs --board /ti/boards/.meta/CC3220S_LAUNCHXL
// @versions {"data":"2018050317","timestamp":"2018050317","tool":"1.0.296","templates":"2018050317"}

var GPIO = scripting.addModule("/ti/drivers/GPIO");
var GPIO1 = GPIO.addInstance();
var GPIO2 = GPIO.addInstance();
var GPIO3 = GPIO.addInstance();
var GPIO4 = GPIO.addInstance();
var GPIO5 = GPIO.addInstance();
// Name
GPIO1.$name = "Board_GPIO_LED0";
// Use Hardware
GPIO1.$hardware = system.deviceData.board.components.LED_RED;
var Power = scripting.addModule("/ti/drivers/Power");
// Name
GPIO2.$name = "Board_GPIO_LED1";
// Use Hardware
GPIO2.$hardware = system.deviceData.board.components.LED_GREEN;
// Name
GPIO3.$name = "Board_GPIO_BUTTON0";
// Use Hardware
GPIO3.$hardware = system.deviceData.board.components.SW2;
// Mode
GPIO3.mode = "Dynamic";
// Name
GPIO4.$name = "Board_GPIO_BUTTON1";
// Use Hardware
GPIO4.$hardware = system.deviceData.board.components.SW3;
// Mode
GPIO4.mode = "Dynamic";
// Use Hardware
GPIO5.$hardware = system.deviceData.board.components.LED_YELLOW;
// Name
GPIO5.$name = "Board_GPIO_LED2";
// Suggest solution
GPIO1.gpioPin.$suggestSolution = "64";
// Suggest solution
GPIO2.gpioPin.$suggestSolution = "2";
// Suggest solution
GPIO3.gpioPin.$suggestSolution = "4";
// Suggest solution
GPIO4.gpioPin.$suggestSolution = "15";
// Suggest solution
GPIO5.gpioPin.$suggestSolution = "1";
